// SPDX-License-Identifier: GPL-2.0-or-later OR MIT

#include "mt7621_qihoo_360-router-t6x.dtsi"

/ {
	compatible = "qihoo,360-router-t6gs", "mediatek,mt7621-soc";
	model = "Qihoo 360 Router T6GS";
};

